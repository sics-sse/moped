AUTOSAR XML (schema 4-0-3)
package /ArcCore/EcucDefs/Generic
  module definition Det [0..1]: refined-module-def=Det, variants pre-compile  # Det configuration includes the functions to be called at notification. On one | side the application functions are specified and in general it can be decided whether Dlt shall be called at each call of Det.
    container DetGeneral  # Generic configuration parameters of the Det module.
      boolean DetForwardToDlt [0..1]: set at pre-compile, default-value=0  # Only if the parameter is present and set to true, the Det requires the Dlt interface and forwards it's call to the function Dlt_DetForwardErrorTrace. In this case the optional interface to Dlt_Det is required.
      boolean DetVersionInfoApi: set at pre-compile, default-value=0  # Pre-processor switch to enable / disable the API to read out the modules version information. | true: Version info API enabled. false: Version info API disabled.
      boolean DetUseRamlog: set at pre-compile, default-value=1  # Switch ON / OFF the logging of errors to ramlog
      boolean DetEnableCallbacks: set at pre-compile, default-value=0  # Switches the Development Error Tracer callbacks interface ON or OFF
      boolean DetWrapRamlog: set at pre-compile, default-value=1  # True if the DET ramlog should wrap when reaching the end.
      boolean DetUseStdErr: set at pre-compile, default-value=0  # Switch ON / OFF the logging of errors to STDERR
      boolean DetDeInitAPI: set at pre-compile, default-value=0  # Enable / Disable the DeInitAPI of this module.
      integer DetNumberOfCallbacks: 1..255, set at pre-compile, default-value=5  # Specifies the number of callbacks that can be registered in DET.
      integer DetRamlogSize: 1..255, set at pre-compile, default-value=16  # Specifies the number of entries in the DET ramlog.
    container DetNotification [0..1]  # Configuration of the notification functions.
      function name DetErrorHook [0..*]: set at pre-compile  # Optional list of functions to be called by the Development Error Tracer in context of each call of Det_ReportError. | The type of these functions shall be identical the type of Det_ReportError itself: Std_ReturnType (*f)(uint16, uint8, uint8, uint8).
    container ArcDetSwcPort [0..*]  # Container defining an interface port to a software component
      integer ModuleId: 4096..65535, set at link in variant link-time / pre-compile in variant pre-compile  # Defines the ModuleId used when SWC reports errors.
package /ArcCore/EcucDefs/Generic/Implementations
  bsw implementation Det: programming-language=C, sw-version=1.0.0, used-code-generator=generators::generic::Det::main, vendor-id=60, ar-release-version=4.0.3, vendor-specific-module-def=Det
